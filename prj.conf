## CMakeLists.txt
```
cmake_minimum_required(VERSION 3.20.0)

find_package(Zephyr REQUIRED HINTS $ENV{ZEPHYR_BASE})
project(bus485)

target_sources(app PRIVATE
    src/bus485.c
)
target_include_directories(app PRIVATE
    inc
)

set(DTS_ROOT ${CMAKE_CURRENT_SOURCE_DIR}/dts)
```

## Kconfig
```
menuconfig BUS_485
    bool "Extention for SPI driver with bus locking"
    depends on SPI
    help
      Enable extended SPI driver with semaphore-based bus locking

if BUS_485

config BUS_485_MAX_CLIENTS
    int "Maximum number of SPI bus clients"
    default 8
    help
      Maximum number of devices that can wait for SPI bus access

config BUS_485_LOCK_TIMEOUT_MS
    int "Default SPI bus lock timeout (ms)"
    default 100
    help
      Default timeout for acquiring SPI bus lock

endif # BUS_485
```

## Kconfig.bus485
```
# BUS485 Driver Configuration

mainmenu "RS485 Bus Driver Configuration"

config BUS485
		bool "RS485 Bus Driver"
		depends on UART_INTERRUPT_DRIVEN
		help
			Enable RS485 driver with exclusive bus access

if BUS485

config RS485_INIT_PRIORITY
		int "Bus initialization priority"
		default 80
		range 0 99
		help
			Initialization priority within _level

endif # BUS485

source "Kconfig.zephyr"
```

## prj.conf
```kconfig
CONFIG_BUS485=y
CONFIG_BUS485_INIT_PRIORITY=80
```

## bus485.overlay
```dts
/ {
    bus485_inst: bus485 {
        compatible = "custom,bus485";
        uart = <&uart0>;
        de-re-gpios = <&gpio0 12 GPIO_ACTIVE_HIGH>;
        current-speed = <9600>;
        pre-delay-us = <50>;
        post-delay-us = <50>;
        status = "okay";
    };
};
```

## dts/bindings/bus485_extention.yaml
```yaml
description: Extended SPI controller with bus locking
compatible: "vendor,spi-extended"
include: spi-controller.yaml

properties:
  cs-gpios:
    type: phandle-array
    required: false
    description: GPIO pins for chip select
```

## dts/bindings/rs485/custom,bus485.yaml
```yaml
# SPDX-License-Identifier: Apache-2.0

description: |
  Custom RS485 bus driver with DE/RE control and interrupt support

compatible: "custom,bus485"

include: [uart.yaml, gpio.yaml]

properties:
  uart:
    type: phandle
    required: true
    description: |
      phandle to UART device used for communication

  de-re-gpios:
    type: phandle-array
    required: true
    description: |
      GPIO specifier for DE/RE control pin (active high/low)

  pre-delay-us:
    type: int
    required: false
    default: 50
    description: |
      Delay (in microseconds) between activating DE and starting transmission

  post-delay-us:
    type: int
    required: false
    default: 50
    description: |
      Delay (in microseconds) after transmission before deactivating DE

  current-speed:
    type: int
    required: false
    default: 9600
    description: |
      Initial baud rate for the UART

required:
  - uart
  - de-re-gpios

examples:
  - |
    bus485 {
        compatible = "custom,bus485";
        uart = <&uart0>;
        de-re-gpios = <&gpio0 12 GPIO_ACTIVE_HIGH>;
        pre-delay-us = <100>;
        post-delay-us = <100>;
        current-speed = <115200>;
    };
```

## inc/bus485.h
```c
#ifndef ZEPHYR_DRIVERS_BUS485_H_
#define ZEPHYR_DRIVERS_BUS485_H_

#include <zephyr/device.h>
#include <zephyr/kernel.h>

#ifdef __cplusplus
extern "C" {
#endif
struct bus485_driver_api {
    int32_t (*lock)(const struct device *dev);
    int32_t (*release)(const struct device *dev);
    int32_t (*send)(const struct device *dev, const uint8_t *buffer, uint32_t count);
    int32_t (*recv)(const struct device *dev, uint8_t *buffer, uint32_t buffer_size, uint32_t timeout_ms);
    int32_t (*flush)(const struct device *dev);
    int32_t (*set_baudrate)(const struct device *dev, uint32_t baudrate);
};

/**
 * @brief Захват эксклюзивного доступа к шине
 * @param dev Указатель на устройство RS485
 * @return 0 при успехе, -EBUSY при занятой шине, -EIO при ошибке
 */
static int32_t bus485_lock(const struct device *dev);

/**
 * @brief Освобождение шины
 * @param dev Указатель на устройство RS485
 * @return 0 при успехе, -EIO при ошибке
 */
static int32_t bus485_release(const struct device *dev);

/**
 * @brief Отправка данных по шине
 * @param dev Указатель на устройство RS485
 * @param buffer Буфер с данными для отправки
 * @param count Размер данных в байтах
 * @return Количество отправленных байт или код ошибки
 */
static int32_t bus485_send(const struct device *dev, const uint8_t *buffer, uint32_t count);

/**
 * @brief Прием данных с шины
 * @param dev Указатель на устройство RS485
 * @param buffer Буфер для записи данных
 * @param buffer_size Максимальный размер буфера
 * @param timeout_ms Таймаут ожидания в миллисекундах
 * @return Количество принятых байт или код ошибки
 */
static int32_t bus485_recv(const struct device *dev, uint8_t *buffer, 
                   uint32_t buffer_size, uint32_t timeout_ms);

/**
 * @brief Очистка буферов приема/передачи
 * @param dev Указатель на устройство RS485
 * @return 0 при успехе, код ошибки при неудаче
 */
static int32_t bus485_flush(const struct device *dev);

/**
 * @brief Установка скорости обмена
 * @param dev Указатель на устройство RS485
 * @param baudrate Новая скорость (например, 9600, 115200)
 * @return 0 при успехе, код ошибки при неудаче
 */
static int32_t bus485_set_baudrate(const struct device *dev, uint32_t baudrate);

#ifdef __cplusplus
}
#endif

#endif /* ZEPHYR_DRIVERS_BUS485_H_ */
```

## include/bus485.h
```c
#ifndef ZEPHYR_DRIVERS_BUS_485_H_
#define ZEPHYR_DRIVERS_BUS_485_H_

#include <zephyr/drivers/spi.h>

/* Client management API */
int bus_485_register_client(const struct device *dev, void *client);
int bus_485_unregister_client(const struct device *dev, void *client);

#endif /* ZEPHYR_DRIVERS_BUS_485_H_ */
```

## include/manager.h
```c
#ifndef SPI_BUS_MANAGER_H
#define SPI_BUS_MANAGER_H

int32_t bus485_lock(const struct device * dev);
int32_t bus485_release(const struct device * dev);
int32_t bus485_send(const struct device * dev,
                    const uint8_t * buffer,
                    uint32_t count);
int32_t bus485_recv(const struct device * dev,
                    uint8_t * buffer,
                    uint32_t buffer_size,
                    uint32_t timeout_ms);
int32_t bus485_flush(const struct device * dev);
int32_t bus485_set_baudrate(const struct device * dev,
                            uint32_t baudrate);


#endif /* SPI_BUS_MANAGER_H */
```

## src/bus485.c
```c
#include "bus485.h"
#include <zephyr/drivers/uart.h>
#include <zephyr/drivers/gpio.h>
#include <zephyr/logging/log.h>

LOG_MODULE_REGISTER(bus485, CONFIG_BUS485_LOG_LEVEL);

/* Конфигурация драйвера */
struct bus485_config 
{
    struct uart_config uart_cfg;
    struct gpio_dt_spec de_re;
    
    /* Настройки */
    uint32_t current_baudrate;
    uint32_t pre_delay_us;
    uint32_t post_delay_us;
};

/* Структура данных драйвера */
struct bus485_data
{
    /* Аппаратные ресурсы */
    const struct device *uart;

    /* Синхронизация */
    struct k_sem tx_sem;
    struct k_sem rx_sem;
    struct k_sem bus_sem;

    /* Буферы */
    uint8_t *rx_buf;
    uint32_t rx_buf_size;
    volatile uint32_t rx_received;
};

/* API реализации */
static int32_t bus485_lock(const struct device *dev)
{
    struct bus485_data *data = dev->data;

    if (k_sem_take(&data->bus_sem, K_MSEC(100)))
    {
        LOG_ERR("Bus acquisition timeout");
        return -EBUSY;
    }

    return 0;
}

static int32_t bus485_release(const struct device *dev)
{
    struct bus485_data *data = dev->data;
    k_sem_give(&data->bus_sem);
    return 0;
}

static int32_t bus485_send(const struct device *dev,
                           const uint8_t *buffer, uint32_t count)
{
    struct bus485_data *data = dev->data;
    const struct bus485_config *cfg = dev->config;

    /* Захватываем право на передачу */
    if (k_sem_take(&data->tx_sem, K_MSEC(100))) {
        return -EBUSY;
    }

    /* Активируем передатчик */
    gpio_pin_set_dt(&cfg->de_re, 1);
    k_usleep(cfg->pre_delay_us);

    /* Включаем прерывания передачи */
    uart_irq_tx_enable(data->uart);

    /* Отправка данных через FIFO */
    for (uint32_t i = 0; i < count; i++) {
        while (!uart_irq_tx_ready(data->uart)) {
            k_yield();
        }
        uart_fifo_fill(data->uart, &buffer[i], 1);
    }

    /* Ждем завершения передачи */
    while (!uart_irq_tx_complete(data->uart)) {
        k_yield();
    }

    /* Деактивируем передатчик */
    k_usleep(cfg->post_delay_us);
    gpio_pin_set_dt(&cfg->de_re, 0);
    uart_irq_tx_disable(data->uart);

    k_sem_give(&data->tx_sem);
    return count;
}

static int32_t bus485_recv(const struct device *dev,
                           uint8_t *buffer, uint32_t buffer_size,
                           uint32_t timeout_ms)
{
    struct bus485_data *data = dev->data;
    const struct bus485_config *cfg = dev->config;

    /* Настраиваем буфер приема */
    data->rx_buf = buffer;
    data->rx_buf_size = buffer_size;
    data->rx_received = 0;

    /* Убедимся, что передатчик выключен */
    gpio_pin_set_dt(&cfg->de_re, 0);

    /* Ждем данные с таймаутом */
    if (k_sem_take(&data->rx_sem, K_MSEC(timeout_ms))) {
        return -ETIMEDOUT;
    }

    return data->rx_received;
}

static int32_t bus485_flush(const struct device *dev)
{
    struct bus485_data *data = dev->data;
    uint8_t dummy;

    while (uart_poll_in(data->uart, &dummy) == 0)
    {
        /* Читаем и отбрасываем все данные */
    }

    return 0;
}

static int32_t bus485_set_baudrate(const struct device *dev, uint32_t baudrate)
{
    struct bus485_data *data = dev->data;
    
    struct uart_config cfg;
    int err;

    err = uart_config_get(data->uart, &cfg);
    if (err)
    {
        return err;
    }

    cfg.baudrate = baudrate;
    return uart_configure(data->uart, &cfg);
}

/* Обработчик прерываний UART */
static void uart_isr(const struct device *uart_dev, void *user_data)
{
    const struct device *bus_dev = user_data;
    struct bus485_data *data = bus_dev->data;
    uint8_t byte;

    /* Обработка приема */
    while (uart_irq_update(uart_dev) && uart_irq_rx_ready(uart_dev)) {
        if (uart_fifo_read(uart_dev, &byte, 1) == 1) {
            if (data->rx_received < data->rx_buf_size) {
                data->rx_buf[data->rx_received++] = byte;
            }
        }
    }

    /* Сигнализируем о получении данных */
    k_sem_give(&data->rx_sem);
}

/* Инициализация драйвера */
static int bus485_init(const struct device *dev)
{

    const struct bus485_config *cfg = dev->config;
    struct bus485_data *data = dev->data;
    int ret;

    /* Инициализация GPIO */
    if (!gpio_is_ready_dt(&cfg->de_re)) {
        LOG_ERR("DE/RE GPIO not ready");
        return -ENODEV;
    }
    gpio_pin_configure_dt(&cfg->de_re, GPIO_OUTPUT_INACTIVE);

    /* Инициализация UART */
    ret = uart_configure(data->uart, &cfg->uart_cfg);
    if (ret) {
        LOG_ERR("UART config failed: %d", ret);
        return ret;
    }

    /* Инициализация семафоров */
    k_sem_init(&data->tx_sem, 1, 1);
    k_sem_init(&data->rx_sem, 0, 1);
    k_sem_init(&data->bus_sem, 1, 1);

    /* Регистрация обработчика прерываний */
    uart_irq_callback_user_data_set(data->uart, uart_isr, (void *)dev);
    uart_irq_rx_enable(data->uart);

    LOG_INF("BUS485 initialized (baud: %d)", cfg->uart_cfg.baudrate);
    return 0;
}

/* Devicetree макросы */
#define DT_DRV_COMPAT custom_bus485

static const struct bus485_driver_api bus485_api = {
    .lock = bus485_lock,
    .release = bus485_release,
    .send = bus485_send,
    .recv = bus485_recv,
    .flush = bus485_flush,
    .set_baudrate = bus485_set_baudrate,
};

#define BUS485_DEFINE(n)                                    \
    static struct bus485_data bus485_data_##n;              \
                                                            \
    static const struct bus485_config bus485_config_##n = { \
        .uart = DEVICE_DT_GET(DT_INST_PHANDLE(n, uart)),    \
        .de_re = GPIO_DT_SPEC_INST_GET(n, de_re_gpios),     \
        .current_baudrate = DT_INST_PROP(n, current_speed), \
        .pre_delay_us = DT_INST_PROP(n, pre_delay_us),      \
        .post_delay_us = DT_INST_PROP(n, post_delay_us),    \
        .uart_cfg = { \
            .baudrate = DT_INST_PROP(n, current_speed), \
            .parity = UART_CFG_PARITY_NONE, \
            .stop_bits = UART_CFG_STOP_BITS_1, \
            .data_bits = UART_CFG_DATA_BITS_8, \
            .flow_ctrl = UART_CFG_FLOW_CTRL_NONE \
        } \
    };                                                      \
                                                            \
    DEVICE_DT_INST_DEFINE(n,                                \
                          bus485_init,                      \
                          NULL,                             \
                          &bus485_data_##n,                 \
                          &bus485_config_##n,             \
                          POST_KERNEL,                      \
                          CONFIG_BUS485_INIT_PRIORITY,      \
                          &bus485_api); // <--- Регистрация API

DT_INST_FOREACH_STATUS_OKAY(BUS485_DEFINE)
```

## src/manager.c
```c
#include "manager.h"

struct spi_waiter
{
    sys_snode_t node;
    const void *requester;
};

void spi_bus_lock_init(struct spi_bus_lock *lock, uint32_t timeout_ms)
{
    k_sem_init(&lock->sem, 1, 1);
    k_fifo_init(&lock->waiters);
    atomic_set(&lock->owner_count, 0);
    lock->current_owner = NULL;
    lock->timeout_ms = timeout_ms;
}

int32_t bus485_lock(const struct device *dev)
{
    struct spi_context *ctx = dev->data;

    if (!ctx->lock_initialized)
    {
        return -ENODEV;
    }

    /* Рекурсивный захват тем же владельцем */
    if (ctx->lock.current_owner == requester)
    {
        atomic_inc(&ctx->lock.owner_count);
        return 0;
    }

    /* Попытка захватить семафор */
    if (k_sem_take(&ctx->lock.sem, K_NO_WAIT) == 0)
    {
        ctx->lock.current_owner = requester;
        atomic_set(&ctx->lock.owner_count, 1);
        return 0;
    }

    /* Если шина занята, добавляем в очередь ожидания */
    struct k_fifo *waitq = &ctx->lock.waiters;
    struct spi_waiter_node *node = k_malloc(sizeof(*node));
    if (!node)
    {
        return -ENOMEM;
    }

    node->requester = requester;
    k_fifo_put(waitq, node);

    /* Ожидание семафора с таймаутом */
    int ret = k_sem_take(&ctx->lock.sem, timeout);
    if (ret != 0)
    {
        /* Удаляем из очереди при таймауте */
        struct spi_waiter_node *tmp;
        while ((tmp = k_fifo_get(waitq, K_NO_WAIT)) != NULL)
        {
            if (tmp->requester == requester)
            {
                k_free(tmp);
                break;
            }
            k_fifo_put(waitq, tmp);
        }
        return ret;
    }

    ctx->lock.current_owner = requester;
    atomic_set(&ctx->lock.owner_count, 1);
    return 0;
}

int32_t bus485_release(const struct device *dev)
{
    struct spi_context *ctx = dev->data;

    if (!ctx->lock_initialized)
    {
        return -ENODEV;
    }

    if (ctx->lock.current_owner != requester)
    {
        return -EPERM;
    }

    /* Уменьшаем счетчик рекурсивных захватов */
    if (atomic_dec(&ctx->lock.owner_count) > 1)
    {
        return 0;
    }

    /* Передаем управление следующему в очереди */
    struct spi_waiter_node *next = k_fifo_get(&ctx->lock.waiters, K_NO_WAIT);
    if (next != NULL)
    {
        ctx->lock.current_owner = next->requester;
        atomic_set(&ctx->lock.owner_count, 1);
        k_free(next);
    }
    else
    {
        ctx->lock.current_owner = NULL;
        atomic_set(&ctx->lock.owner_count, 0);
    }

    k_sem_give(&ctx->lock.sem);
    return 0;
}

int32_t bus485_send(const struct device *dev,
                    const uint8_t *buffer,
                    uint32_t count)
{
    return 0;
}

int32_t bus485_recv(const struct device *dev,
                    uint8_t *buffer,
                    uint32_t buffer_size,
                    uint32_t timeout_ms)
{
    return 0;
}
int32_t bus485_flush(const struct device *dev)
{
    return 0;
}
int32_t bus485_set_baudrate(const struct device *dev,
                            uint32_t baudrate)
{
    return 0;
}
```
