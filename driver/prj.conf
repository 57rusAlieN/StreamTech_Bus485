## CMakeLists.txt
```
cmake_minimum_required(VERSION 3.20.0)

set(CMAKE_SKIP_BUILD_RPATH TRUE)

list(APPEND DTS_ROOT ${CMAKE_CURRENT_SOURCE_DIR}/dts)
list(APPEND EXTRA_DTC_OVERLAY_FILE ${CMAKE_CURRENT_SOURCE_DIR}/bus485.overlay)

find_package(Zephyr REQUIRED HINTS $ENV{ZEPHYR_BASE})

# project(bus485_d LANGUAGES C)
# target_sources(app PRIVATE build.debug.main.c)

zephyr_library()
zephyr_include_directories(inc INTERFACE)
zephyr_library_sources(
    src/bus485.c
    inc/bus485.h
)
```

## Kconfig
```
# BUS485 Driver Configuration

menuconfig BUS485
    bool "BUS485 Driver Support"
    depends on UART_INTERRUPT_DRIVEN
    help
      Enable BUS485 driver with semaphore-controlled access

if BUS485

config BUS485_INIT_PRIORITY
    int "Driver initialization priority"
    default 80
    range 0 99
    help
      BUS485 driver device initialization priority.

config BUS485_LOG_LEVEL
    int "Log level"
    default 2
    range 0 4
    help
      BUS485 driver log level (0-4)
config BUS485_RX_QUEUE_SIZE
    int "RX queue size"
    default 1024
    range 32 16384
    help
      Size of the receive queue in bytes (32-16384)
endif # BUS485
#source "Kconfig.zephyr"
```

## prj.conf
```kconfig
CONFIG_UART_INTERRUPT_DRIVEN=y
CONFIG_BUS485=y
CONFIG_BUS485_INIT_PRIORITY=80
CONFIG_GPIO=y
```

## app.overlay
```dts
/ {
    bus485: serial@40005000 {
        compatible = "custom,bus485";
        label = "bus485";  // Обязательно!
        uart = <&uart0>;
        de-re-gpios = <&gpio0 12 1>;
        pre-delay-us = <100>;
        post-delay-us = <100>;
        current-speed = <115200>;
        status = "okay";
    };
};
```

## bus485.overlay
```dts
/ {
	bus485: bus485 {
        compatible = "custom,bus485";
        label = "bus485";
        
        uart = <&uart0>;
        de-re-gpios = <&gpio0 4 0>; // 0 - GPIO_ACTIVE_HIGH; слот для DE/RE?
        pre-delay-us = <100>;
        post-delay-us = <100>;
        current-speed = <115200>;

        status = "okay";
    };
};
```

## dts/bindings/custom,bus485.yaml
```yaml
# SPDX-License-Identifier: Apache-2.0
description: |
  Custom RS485 bus driver with DE/RE control and interrupt support

compatible: "custom,bus485"

include: 
  - uart-controller.yaml

properties:
  uart:
    type: phandle
    required: true
    description: |
      phandle to UART device used for communication

  de-re-gpios:
    type: phandle-array
    required: true
    description: |
      GPIO specifier for DE/RE control pin (active high/low)

  pre-delay-us:
    type: int
    required: true
    default: 50
    description: |
      Delay (in microseconds) between activating DE and starting transmission

  post-delay-us:
    type: int
    required: true
    default: 50
    description: |
      Delay (in microseconds) after transmission before deactivating DE

  current-speed:
    type: int
    required: true
    default: 115200
    description: |
      Initial baud rate for the UART

# examples:
#   - |
#     bus485 {
#         compatible = "custom,bus485";
#         uart = <&uart0>;
#         de-re-gpios = <&gpio0 12 GPIO_ACTIVE_HIGH>;
#         pre-delay-us = <100>;
#         post-delay-us = <100>;
#         current-speed = <115200>;
#     };
```

## dts/bindings/bus485/custom,bus485.yaml
```yaml
# SPDX-License-Identifier: Apache-2.0

description: |
  Custom RS485 bus driver with DE/RE control and interrupt support

compatible: "custom,bus485"

include: ["gpio-controller.yaml", "uart-controller.yaml"]

properties:
  uart:
    type: phandle
    required: true
    description: |
      phandle to UART device used for communication

  de-re-gpios:
    type: phandle-array
    required: true
    description: |
      GPIO specifier for DE/RE control pin (active high/low)

  gpios:
    type: phandle-array
    required: true
    description: |
      GPIO specifier for GPIO control pin (active high/low)

  pre-delay-us:
    type: int
    default: 50
    description: |
      Delay (in microseconds) between activating DE and starting transmission

  post-delay-us:
    type: int
    default: 50
    description: |
      Delay (in microseconds) after transmission before deactivating DE

  current-speed:
    type: int
    default: 115200
    description: |
      Initial baud rate for the UART

# examples:
#   - |
#     bus485 {
#         compatible = "custom,bus485";
#         uart = <&uart0>;
#         de-re-gpios = <&gpio0 12 GPIO_ACTIVE_HIGH>;
#         pre-delay-us = <100>;
#         post-delay-us = <100>;
#         current-speed = <115200>;
#     };
```

## dts/bindings/rs485/custom,bus485.yaml
```yaml
# SPDX-License-Identifier: Apache-2.0

description: |
  Custom RS485 bus driver with DE/RE control and interrupt support

compatible: "custom,bus485"

include: 
  - "st,stm32-uart.yaml"
  - "st,stm32-gpio.yaml"

properties:
  uart:
    type: phandle
    description: |
      phandle to UART device used for communication

  de-re-gpios:
    type: phandle-array
    description: |
      GPIO specifier for DE/RE control pin (active high/low)

  pre-delay-us:
    type: int
    default: 50
    description: |
      Delay (in microseconds) between activating DE and starting transmission

  post-delay-us:
    type: int
    default: 50
    description: |
      Delay (in microseconds) after transmission before deactivating DE

  current-speed:
    type: int
    default: 115200
    description: |
      Initial baud rate for the UART

required:
  - name: uart
  - name: de-re-gpios

# Отключаем проверку дублирования для current-speed
ignore-properties:
  - current-speed

examples:
  - |
    bus485 {
        compatible = "custom,bus485";
        uart = <&uart0>;
        de-re-gpios = <&gpio0 12 GPIO_ACTIVE_HIGH>;
        pre-delay-us = <100>;
        post-delay-us = <100>;
        current-speed = <115200>;
    };
```

## inc/bus485.h
```c
#ifndef ZEPHYR_DRIVERS_BUS485_H_
#define ZEPHYR_DRIVERS_BUS485_H_

#include <zephyr/device.h>
#include <zephyr/kernel.h>

#ifdef __cplusplus
extern "C" {
#endif
struct bus485_driver_api {
    int32_t (*lock)(const struct device *dev);
    int32_t (*release)(const struct device *dev);
    int32_t (*send)(const struct device *dev, const uint8_t *buffer, uint32_t count);
    int32_t (*recv)(const struct device *dev, uint8_t *buffer, uint32_t buffer_size, uint32_t timeout_ms);
    int32_t (*flush)(const struct device *dev);
    int32_t (*set_baudrate)(const struct device *dev, uint32_t baudrate);
};

/**
 * @brief Захват эксклюзивного доступа к шине
 * @param dev Указатель на устройство RS485
 * @return 0 при успехе, -EBUSY при занятой шине, -EIO при ошибке
 */
extern int32_t bus485_lock(const struct device *dev);

/**
 * @brief Освобождение шины
 * @param dev Указатель на устройство RS485
 * @return 0 при успехе, -EIO при ошибке
 */
extern int32_t bus485_release(const struct device *dev);

/**
 * @brief Отправка данных по шине
 * @param dev Указатель на устройство RS485
 * @param buffer Буфер с данными для отправки
 * @param count Размер данных в байтах
 * @return Количество отправленных байт или код ошибки
 */
extern int32_t bus485_send(const struct device *dev, const uint8_t *buffer, uint32_t count);

/**
 * @brief Прием данных с шины
 * @param dev Указатель на устройство RS485
 * @param buffer Буфер для записи данных
 * @param buffer_size Максимальный размер буфера
 * @param timeout_ms Таймаут ожидания в миллисекундах
 * @return Количество принятых байт или код ошибки
 */
extern int32_t bus485_recv(const struct device *dev, uint8_t *buffer, 
                   uint32_t buffer_size, uint32_t timeout_ms);

/**
 * @brief Очистка буферов приема/передачи
 * @param dev Указатель на устройство RS485
 * @return 0 при успехе, код ошибки при неудаче
 */
extern int32_t bus485_flush(const struct device *dev);

/**
 * @brief Установка скорости обмена
 * @param dev Указатель на устройство RS485
 * @param baudrate Новая скорость (например, 9600, 115200)
 * @return 0 при успехе, код ошибки при неудаче
 */
extern int32_t bus485_set_baudrate(const struct device *dev, uint32_t baudrate);

#ifdef __cplusplus
}
#endif

#endif /* ZEPHYR_DRIVERS_BUS485_H_ */
```

## src/=-manager-=(на будущее).c
```c
#include "manager.h"

struct spi_waiter
{
    sys_snode_t node;
    const void *requester;
};

void spi_bus_lock_init(struct spi_bus_lock *lock, uint32_t timeout_ms)
{
    k_sem_init(&lock->sem, 1, 1);
    k_fifo_init(&lock->waiters);
    atomic_set(&lock->owner_count, 0);
    lock->current_owner = NULL;
    lock->timeout_ms = timeout_ms;
}

int32_t bus485_lock(const struct device *dev)
{
    struct spi_context *ctx = dev->data;

    if (!ctx->lock_initialized)
    {
        return -ENODEV;
    }

    /* Рекурсивный захват тем же владельцем */
    if (ctx->lock.current_owner == requester)
    {
        atomic_inc(&ctx->lock.owner_count);
        return 0;
    }

    /* Попытка захватить семафор */
    if (k_sem_take(&ctx->lock.sem, K_NO_WAIT) == 0)
    {
        ctx->lock.current_owner = requester;
        atomic_set(&ctx->lock.owner_count, 1);
        return 0;
    }

    /* Если шина занята, добавляем в очередь ожидания */
    struct k_fifo *waitq = &ctx->lock.waiters;
    struct spi_waiter_node *node = k_malloc(sizeof(*node));
    if (!node)
    {
        return -ENOMEM;
    }

    node->requester = requester;
    k_fifo_put(waitq, node);

    /* Ожидание семафора с таймаутом */
    int ret = k_sem_take(&ctx->lock.sem, timeout);
    if (ret != 0)
    {
        /* Удаляем из очереди при таймауте */
        struct spi_waiter_node *tmp;
        while ((tmp = k_fifo_get(waitq, K_NO_WAIT)) != NULL)
        {
            if (tmp->requester == requester)
            {
                k_free(tmp);
                break;
            }
            k_fifo_put(waitq, tmp);
        }
        return ret;
    }

    ctx->lock.current_owner = requester;
    atomic_set(&ctx->lock.owner_count, 1);
    return 0;
}

int32_t bus485_release(const struct device *dev)
{
    struct spi_context *ctx = dev->data;

    if (!ctx->lock_initialized)
    {
        return -ENODEV;
    }

    if (ctx->lock.current_owner != requester)
    {
        return -EPERM;
    }

    /* Уменьшаем счетчик рекурсивных захватов */
    if (atomic_dec(&ctx->lock.owner_count) > 1)
    {
        return 0;
    }

    /* Передаем управление следующему в очереди */
    struct spi_waiter_node *next = k_fifo_get(&ctx->lock.waiters, K_NO_WAIT);
    if (next != NULL)
    {
        ctx->lock.current_owner = next->requester;
        atomic_set(&ctx->lock.owner_count, 1);
        k_free(next);
    }
    else
    {
        ctx->lock.current_owner = NULL;
        atomic_set(&ctx->lock.owner_count, 0);
    }

    k_sem_give(&ctx->lock.sem);
    return 0;
}

int32_t bus485_send(const struct device *dev,ё
                    const uint8_t *buffer,
                    uint32_t count)
{
    return 0;
}

int32_t bus485_recv(const struct device *dev,
                    uint8_t *buffer,
                    uint32_t buffer_size,
                    uint32_t timeout_ms)
{
    return 0;
}
int32_t bus485_flush(const struct device *dev)
{
    return 0;
}
int32_t bus485_set_baudrate(const struct device *dev,
                            uint32_t baudrate)
{
    return 0;
}
```

## src/bus485.c
```c
#include "bus485.h"
#include <zephyr/drivers/uart.h>
#include <zephyr/drivers/gpio.h>
#include <zephyr/logging/log.h>

LOG_MODULE_REGISTER(bus485, CONFIG_BUS485_LOG_LEVEL);

/* Конфигурация драйвера */
struct bus485_config 
{
    struct uart_config uart_cfg;
    struct gpio_dt_spec de_re;
    
    /* Настройки */
    uint32_t current_baudrate;
    uint32_t pre_delay_us;
    uint32_t post_delay_us;
};

/* Структура данных драйвера */
struct bus485_data
{
    /* Аппаратные ресурсы */
    const struct device *uart;

    /* Синхронизация */
    struct k_sem tx_sem;
    struct k_sem bus_sem;

    /* Очередь приема */
    uint8_t rx_buf[CONFIG_BUS485_RX_QUEUE_SIZE];
    uint16_t rx_head;
    uint16_t rx_tail;
    struct k_mutex rx_mutex;
};

/* API реализации */
int32_t bus485_lock(const struct device *dev)
{
    struct bus485_data *data = dev->data;

    if (k_sem_take(&data->bus_sem, K_MSEC(100)))
    {
        LOG_ERR("Bus acquisition timeout");
        return -EBUSY;
    }

    return 0;
}

int32_t bus485_release(const struct device *dev)
{
    struct bus485_data *data = dev->data;
    k_sem_give(&data->bus_sem);
    return 0;
}

int32_t bus485_send(const struct device *dev,
                           const uint8_t *buffer, uint32_t count)
{
    struct bus485_data *data = dev->data;
    const struct bus485_config *cfg = dev->config;

    /* Захватываем право на передачу */
    if (k_sem_take(&data->tx_sem, K_MSEC(100))) {
        return -EBUSY;
    }

    /* Активируем передатчик */
    gpio_pin_set_dt(&cfg->de_re, 1);
    k_usleep(cfg->pre_delay_us);

    /* Включаем прерывания передачи */
    uart_irq_tx_enable(data->uart);

    /* Отправка данных через FIFO */
    for (uint32_t i = 0; i < count; i++) {
        while (!uart_irq_tx_ready(data->uart)) {
            k_yield();
        }
        uart_fifo_fill(data->uart, &buffer[i], 1);
    }

    /* Ждем завершения передачи */
    while (!uart_irq_tx_complete(data->uart)) {
        k_yield();
    }

    /* Деактивируем передатчик */
    k_usleep(cfg->post_delay_us);
    gpio_pin_set_dt(&cfg->de_re, 0);
    uart_irq_tx_disable(data->uart);

    k_sem_give(&data->tx_sem);
    return count;
}

int32_t bus485_recv(const struct device *dev,
                           uint8_t *buffer, uint32_t buffer_size,
                           uint32_t timeout_ms)
{
    struct bus485_data *data = dev->data;
    const struct bus485_config *cfg = dev->config;

    /* Настраиваем буфер приема */
    // data->rx_buf = buffer;
    // data->rx_buf_size = buffer_size;
    uint32_t rx_received = 0;

    /* Убедимся, что передатчик выключен */
    gpio_pin_set_dt(&cfg->de_re, 0);

    /* Читаем данные из очереди с таймаутом */
    while (rx_received < buffer_size) {
        if (k_mutex_lock(&data->rx_mutex, K_MSEC(timeout_ms))) return −EAGAIN;
        
        if (data->rx_tail != data->rx_head) {
            buffer[rx_received++] = data->rx_buf[data->rx_tail];
            data->rx_tail = (data->rx_tail + 1) % CONFIG_BUS485_RX_QUEUE_SIZE;
            k_mutex_unlock(&data->rx_mutex);
        } else {
            /// Очередь пуста
            k_mutex_unlock(&data->rx_mutex);
            break;
        }
    }
    return rx_received;
}

int32_t bus485_flush(const struct device *dev)
{
    struct bus485_data *data = dev->data;
    uint8_t dummy;

    while (uart_poll_in(data->uart, &dummy) == 0)
    {
        /* Читаем и отбрасываем все данные */
    }

    /* Сбрасываем очередь */
    data->rx_head = 0;
    data->rx_tail = 0;

    return 0;
}

int32_t bus485_set_baudrate(const struct device *dev, uint32_t baudrate)
{
    struct bus485_data *data = dev->data;
    
    struct uart_config cfg;
    int err;

    err = uart_config_get(data->uart, &cfg);
    if (err)
    {
        return err;
    }

    cfg.baudrate = baudrate;
    return uart_configure(data->uart, &cfg);
}

/* Обработчик прерываний UART */
static void uart_isr(const struct device *uart_dev, void *user_data)
{
    const struct device *bus_dev = user_data;
    struct bus485_data *data = bus_dev->data;
    uint8_t byte;

    /* Обработка приема */
    while (uart_irq_update(uart_dev) && uart_irq_rx_ready(uart_dev)) {
        if (uart_fifo_read(uart_dev, &byte, 1) == 1){
            /* Блокируем очередь */
            k_mutex_lock(&data->rx_mutex, K_FOREVER);
            uint16_t next_head = (data->rx_head + 1) % CONFIG_BUS485_RX_QUEUE_SIZE;
            
            if (next_head != data->rx_tail) {
                data->rx_buf[data->rx_head] = byte;
                data->rx_head = next_head;
            }
            /* Сигнализируем о получении данных */
            k_mutex_unlock(&data->rx_mutex);
        }
    }
}

/* Инициализация драйвера */
static int bus485_init(const struct device *dev)
{

    const struct bus485_config *cfg = dev->config;
    struct bus485_data *data = dev->data;
    int ret;

    /* Инициализация GPIO */
    if (!gpio_is_ready_dt(&cfg->de_re)) {
        LOG_ERR("DE/RE GPIO not ready");
        return -ENODEV;
    }
    gpio_pin_configure_dt(&cfg->de_re, GPIO_OUTPUT_INACTIVE);

    /* Инициализация UART */
    ret = uart_configure(data->uart, &cfg->uart_cfg);
    if (ret) {
        LOG_ERR("UART config failed: %d", ret);
        return ret;
    }

    /* Инициализация семафоров */
    k_sem_init(&data->tx_sem, 1, 1);
    k_sem_init(&data->bus_sem, 1, 1);

    /* Инициализация очереди приема */
    k_mutex_init(&data->rx_mutex);
    data->rx_head = 0;
    data->rx_tail = 0;

    /* Регистрация обработчика прерываний */
    uart_irq_callback_user_data_set(data->uart, uart_isr, (void *)dev);
    uart_irq_rx_enable(data->uart);

    LOG_INF("BUS485 initialized (baud: %d)", cfg->uart_cfg.baudrate);
    return 0;
}

/* Devicetree макросы */
#define DT_DRV_COMPAT custom_bus485
#define BUS485_DRV_COMPAT custom_bus485


const struct bus485_driver_api bus485_api = {
    .lock = bus485_lock,
    .release = bus485_release,
    .send = bus485_send,
    .recv = bus485_recv,
    .flush = bus485_flush,
    .set_baudrate = bus485_set_baudrate,
};

#ifdef BUS485_USE_MULTIPLE_INSTANCE
/// Multiple instances
#define BUS485_NODE DT_NODELABEL(bus485)
#define BUS485_DEFINE(n)                                    \
    struct bus485_data bus485_data_##n;              \
                                                            \
    const struct bus485_config bus485_config_##n = { \
        .de_re = GPIO_DT_SPEC_INST_GET(n, de_re_gpios),     \
        .current_baudrate = DT_INST_PROP(n, current_speed), \
        .pre_delay_us = DT_INST_PROP(n, pre_delay_us),      \
        .post_delay_us = DT_INST_PROP(n, post_delay_us),    \
        .uart_cfg = { \
            .baudrate = DT_INST_PROP(n, current_speed), \
            .parity = UART_CFG_PARITY_NONE, \
            .stop_bits = UART_CFG_STOP_BITS_1, \
            .data_bits = UART_CFG_DATA_BITS_8, \
            .flow_ctrl = UART_CFG_FLOW_CTRL_NONE \
        } \
    };                                                      \
                                                            \
    DEVICE_DT_INST_DEFINE(n,             \
                        bus485_init,                      \
                        NULL,                             \
                        &bus485_data_##n,                 \
                        &bus485_config_##n,               \
                        POST_KERNEL,                      \
                        CONFIG_BUS485_INIT_PRIORITY,      \
                        &bus485_api); // <--- Регистрация API

DT_INST_FOREACH_STATUS_OKAY(BUS485_DEFINE)

#else
/// Single instance
#define BUS485_NODE DT_PATH(bus485)
struct bus485_data bus485_data;
const struct bus485_config bus485_config = { 
    //.de_re = GPIO_DT_SPEC_GET(DT_PATH(bus485), de_re_gpios),     
    .current_baudrate = DT_PROP(BUS485_NODE, current_speed), 
    .pre_delay_us = DT_PROP(BUS485_NODE, pre_delay_us),      
    .post_delay_us = DT_PROP(BUS485_NODE, post_delay_us),    
    .uart_cfg = { 
        .baudrate = DT_PROP(BUS485_NODE, current_speed), 
        .parity = UART_CFG_PARITY_NONE, 
        .stop_bits = UART_CFG_STOP_BITS_1, 
        .data_bits = UART_CFG_DATA_BITS_8, 
        .flow_ctrl = UART_CFG_FLOW_CTRL_NONE 
    } 
};                                                      

DEVICE_DT_DEFINE(BUS485_NODE,             \
                    bus485_init,                      \
                    NULL,                             \
                    &bus485_data,                 \
                    &bus485_config,               \
                    POST_KERNEL,                      \
                    CONFIG_BUS485_INIT_PRIORITY,      \
                    &bus485_api); // <--- Регистрация API
#endif // BUS485_USE_MULTIPLE_INSTANCE
```
